## config/boards/shields/corne5c/Kconfig.shield
```kconfig
# Copyright (c) 2022 beta-tank
# SPDX-License-Identifier: MIT

config SHIELD_CORNE5c
	def_bool $(shields_list_contains,corne5c)
```

## config/west.yml
```yaml
manifest:
  remotes:
    - name: urob
      url-base: https://github.com/urob
  projects:
    - name: zmk
      remote: urob
      revision: mouse-3.2
      import: app/west.yml
  self:
    path: config
```
