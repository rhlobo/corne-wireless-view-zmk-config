#include <dt-bindings/zmk/mouse.h>


// MOUSE CONFIGS
// Mouse movement: Configurable acceleration profile with three parameters:
// - delay before movement
// - time to max speed
// - acceleration exponent: The exponent is usually set to:
//   - 0 for constant speed
//   - 1 for uniform acceleration
//   - 2 for uniform jerk
&mmv {
    acceleration-exponent=<1>;
    time-to-max-speed-ms = <1500>;
    delay-ms = <0>;
};

// Scrolling: Configurable acceleration profile with three parameters:
// - delay before movement
// - time to max speed
// - acceleration exponent: The exponent is usually set to:
//   - 0 for constant speed
//   - 1 for uniform acceleration
//   - 2 for uniform jerk
&mwh {
    acceleration-exponent=<1>;
    time-to-max-speed-ms = <3000>;
    delay-ms = <0>;
};



#define U_WH_U &mwh SCROLL_UP
#define U_WH_D &mwh SCROLL_DOWN
#define U_WH_L &mwh SCROLL_LEFT
#define U_WH_R &mwh SCROLL_RIGHT
